## arch/arm/mach-pxa/loox720/Kconfig
```kconfig
menuconfig MACH_LOOX720
	bool "FSC Loox 720"
	select PXA27x
	select INPUT_KEYBOARD
	select KEYBOARD_GPIO
	help
	  Enable this if you plan to boot the kernel on the Loox 720
	  series of PDAs. Currently there is only basic support for this
	  type of PDAs.

config LOOX720_LCD
	tristate "FSC Loox 720 LCD"
	depends on MACH_LOOX720
	help
	  This driver provides support for changing power and brightness
	  on Loox 720 LCD display.

config LOOX720_TS
    tristate "FSC Loox 720 Touchscreen"
    depends on MACH_LOOX720
    help
      This driver provides support for touchscreen.

config LOOX720_BUTTONS
    tristate "FSC Loox 720 Buttons"
    depends on MACH_LOOX720
    select KEYBOARD_PXA27x
    help
      FSC Loox 720 buttons support.

config LOOX720_BT
    tristate "FSC Loox 720 Bluetooth (BRF6150)"
    depends on MACH_LOOX720
    help
      FSC Loox 720 Bluetooth (BRF6150) support. Should be working good.

config DRAM_BASE
	hex '(S)DRAM Base Address'
	depends on MACH_LOOX720
	default 0xaa000000
	help
		On the Loox 720, RAM starts at 0xaa000000. You should not
		need to modify this value.

config CONFIG_LOOX720_LIMIT_CPUFREQ
	bool 'Limit high CPU frequency to 520MHz'
	depends on MACH_LOOX720
	default yes
	help
		Not all LOOX pdas work on 624MHz. So, to avoid hangs, enable this.

config CONFIG_LOOX720_GPIOED
	tristate 'access GPIO from userland'
	depends on MACH_LOOX720
	default m
	help
		Enable this to allow GPIO access from userland.

config LOOX720_CPLD_EDIT
	tristate 'access CPLD bits from userland'
	depends on MACH_LOOX720
	default m
	help
		Enable this to allow CPLD bits access from userland.

config LOOX720_PCMCIA
	tristate 'FSC Loox 720 CF/PC Card'
	depends on MACH_LOOX720 && PCMCIA_PXA2XX
	default m
	help
		Enable CF/PC Card controller in Loox 720
```
